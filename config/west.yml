## config/west.yml
```yaml
manifest:
  remotes:
    - name: zmkfirmware
      url-base: https://github.com/zmkfirmware
    - name: sekigon-gonnoc
      url-base: https://github.com/sekigon-gonnoc
    - name: kot149
      url-base: https://github.com/kot149
    - name: hamehame2
      url-base: https://github.com/hamehame2
    # - name: caksoylar
    # url-base: https://github.com/caksoylar
    - name: kot149
      url-base: https://github.com/kot149
  projects:
    - name: zmk
      remote: zmkfirmware
      #revision: main
      revision: v0.2
      import: app/west.yml
      
    - name: zmk-driver-paw3222
      remote: sekigon-gonnoc
      revision: main
    - name: zmk-layout-shift
      remote: kot149
      revision: v1
   # - name: zmk-naginata
   # - name: zmk-behavior-mejiro
    - name: zmk-behavior-plover64    
      remote: hamehame2
      revision: main
    # - name: zmk-rgbled-widget
    #  remote: caksoylar
    #  revision: main
    - name: zmk-mouse-gesture
      remote: kot149
      revision: v1
  self:
    path: config
```
