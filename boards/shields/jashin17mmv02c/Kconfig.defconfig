## boards/shields/jashin17mmv02c/Kconfig.defconfig
```kconfig
if SHIELD_JASHIN17MMV02C_RIGHT

config ZMK_KEYBOARD_NAME
    default "jashin17mmv02c"

endif

if SHIELD_JASHIN17MMV02C_LEFT || SHIELD_JASHIN17MMV02C_RIGHT

config ZMK_SPLIT
    default y

endif
```

## boards/shields/jashin17mmv02c/Kconfig.shield
```kconfig
config SHIELD_JASHIN17MMV02C_LEFT
    def_bool $(shields_list_contains,jashin17mmv02c_left)
config SHIELD_JASHIN17MMV02C_RIGHT
    def_bool $(shields_list_contains,jashin17mmv02c_right)
```
